## STEM_V3/main/Kconfig.projbuild
```kconfig
menu "STEM_V3 Configuration"

    config STEM_MAX_TORQUE_PERMILLE
        int "Maximum torque limit the console / CLI may set (per-thousand of rated)"
        range 0 3000
        default 500
        help
            Ceiling for the torque limit written to every Eyou actuator's
            Max torque object (0x6072, per-thousand of the rated torque). The
            web console's SET_TORQUE_LIMIT and the CLI's torque_limit refuse a
            value above this, so a browser cannot ask the linkage to push
            harder than the person who flashed it allowed. The drive clamps its
            torque demand to the limit in every mode, so a profile-position
            move cannot exceed it either. 1000 = the rated torque.

    config STEM_BOOT_TORQUE_PERMILLE
        int "Torque limit written at boot (per-thousand of rated)"
        range 0 3000
        default 300
        help
            Written to every motor before the drives are enabled (nothing moves
            harder than this until someone raises the limit from the console
            or the CLI); capped to STEM_MAX_TORQUE_PERMILLE. Found on the
            single-actuator test stand: a torque-limited move is how the
            mechanical limits are found without breaking a linkage.

endmenu
```

## pear_linkage/main/Kconfig.projbuild
```kconfig
menu "PEAR Linkage Console Configuration"

    config LINKAGE_CAN_TX_GPIO
        int "CAN (TWAI) TX GPIO"
        range 0 54
        default 17
        help
            TWAI TX, to the CAN transceiver's TXD (17 on the ESP32-P4-ETH as
            wired for the other projects in this repository).

    config LINKAGE_CAN_RX_GPIO
        int "CAN (TWAI) RX GPIO"
        range 0 54
        default 16
        help
            TWAI RX, from the CAN transceiver's RXD (16 on the ESP32-P4-ETH).

    config LINKAGE_CAN_BITRATE
        int "CAN bitrate (bit/s)"
        default 1000000
        help
            The Eyou actuators run 1 Mbit/s; it must match the drives.

    config LINKAGE_MOTOR1_NODE_ID
        int "Default node id of the crank 1 (M1) motor"
        range 0 127
        default 1
        help
            The firmware default; the console's settings (saved in NVS) take
            precedence once set. 0 = no motor on this crank.

    config LINKAGE_MOTOR2_NODE_ID
        int "Default node id of the crank 2 (M2) motor"
        range 0 127
        default 2

    config LINKAGE_POLL_PERIOD_MS
        int "Poll period (ms)"
        range 20 1000
        default 100
        help
            How often the device reads position / velocity / torque / current /
            statusword from both motors (ten SDO reads) and builds a STATUS.

    config LINKAGE_MAX_TORQUE_PERMILLE
        int "Maximum torque limit the console may set (per-thousand of rated)"
        range 0 3000
        default 500
        help
            The CEILING for each motor's torque limit in the settings: the
            device refuses settings above it. 1000 = the rated torque.

    config LINKAGE_DEFAULT_TORQUE_PERMILLE
        int "Default torque limit (per-thousand of rated)"
        range 0 3000
        default 300
        help
            The torque limit in the default settings (clamped to the maximum).

    choice LINKAGE_USB_PORT
        prompt "USB port"
        default LINKAGE_USB_PORT_HIGH_SPEED
        help
            Waveshare ESP32-P4-ETH (the default): the USB 2.0 high-speed OTG
            signals are on the 4-pin MX1.25 "USB" connector (D+ / D- / GND to
            the PC); the Type-C is a CH343 UART bridge (flashing + console).
            Dev kits with the USB-Serial-JTAG pad pair (GPIO 24 / 25) on a
            USB-C can run the full-speed controller on those pads instead.

        config LINKAGE_USB_PORT_HIGH_SPEED
            bool "USB 2.0 high-speed port (ESP32-P4-ETH: the 4-pin USB connector)"

        config LINKAGE_USB_PORT_FS_USBC
            bool "USB 1.1 full-speed port on the USB-C pads (GPIO 24 / 25)"

        config LINKAGE_USB_PORT_DEFAULT
            bool "TinyUSB's default for the target"
    endchoice

endmenu
```
