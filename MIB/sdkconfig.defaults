## components/eyou_motor/webapp_example/main/Kconfig.projbuild
```kconfig
menu "Eyou Console Configuration"

    config EXAMPLE_CAN_TX_GPIO
        int "CAN (TWAI) TX GPIO"
        range 0 54
        default 17
        help
            TWAI TX, to the CAN transceiver's TXD. 17 on the Waveshare
            ESP32-P4-ETH as wired for the other projects in this repository.

    config EXAMPLE_CAN_RX_GPIO
        int "CAN (TWAI) RX GPIO"
        range 0 54
        default 16
        help
            TWAI RX, from the CAN transceiver's RXD (16 on the ESP32-P4-ETH).

    config EXAMPLE_CAN_BITRATE
        int "CAN bitrate (bit/s)"
        default 1000000
        help
            The Eyou actuators run 1 Mbit/s; it must match the drive's setting.

    config EXAMPLE_NODE_ID
        int "Eyou CANopen node id"
        range 1 127
        default 1
        help
            The node id of the one actuator on the test stand.

    config EXAMPLE_POLL_PERIOD_MS
        int "Poll period (ms)"
        range 10 1000
        default 50
        help
            How often the device reads the live position / velocity / torque /
            current / statusword from the drive (five SDO reads, a few ms on a
            1 Mbit/s bus) and hands a STATUS snapshot to the console stream.

    config EXAMPLE_MAX_TORQUE_PERMILLE
        int "Maximum torque limit the console may set (per-thousand of rated)"
        range 0 3000
        default 500
        help
            The CEILING for the torque limit: the console sets the drive's max
            torque (object 0x6072) at run time, but never above this value (a
            request above it is refused). 1000 = the rated torque. Pick it for
            the mechanics on the stand; the console works below it.

    config EXAMPLE_BOOT_TORQUE_PERMILLE
        int "Torque limit written at boot (per-thousand of rated)"
        range 0 3000
        default EXAMPLE_MAX_TORQUE_PERMILLE
        help
            Max torque written to the drive at boot, before anything can move,
            and again when a drive appears after boot; clamped to the maximum
            above. The console changes it at run time (up to the maximum).

    config EXAMPLE_PROFILE_VELOCITY_DPS
        int "Profile velocity at boot (deg/s)"
        range 1 3600
        default 30

    config EXAMPLE_PROFILE_ACCEL_DPS2
        int "Profile acceleration at boot (deg/s^2)"
        range 1 36000
        default 20

    config EXAMPLE_PROFILE_DECEL_DPS2
        int "Profile deceleration at boot (deg/s^2)"
        range 1 36000
        default 20

    config EXAMPLE_LOAD_ZERO_AT_BOOT
        bool "Load the saved software zero at boot"
        default y
        help
            Load the zero saved for this node id from NVS (the console's Save
            zero) at boot, so angles are relative to it from the start. Off:
            angles are the encoder's absolute position until a zero is set.

    choice EXAMPLE_USB_PORT
        prompt "USB port"
        default EXAMPLE_USB_PORT_HIGH_SPEED
        help
            Which USB-OTG controller TinyUSB drives, and on which pads.

            Waveshare ESP32-P4-ETH (the default): its Type-C is a CH343
            USB-to-UART bridge (flashing + this firmware's console), NOT a
            USB connection to the ESP32-P4. The chip's USB 2.0 high-speed
            OTG signals are on the 4-pin MX1.25 "USB" connector: wire that to
            the PC (D+ / D- / GND; VBUS is not needed when the board is
            powered from the Type-C) and pick the high-speed port.

            ESP32-P4 dev kits with the USB-Serial-JTAG pad pair (GPIO 24 /
            25) on a USB-C (Espressif, Waveshare WIFI6 kit): the full-speed
            controller can be moved onto those pads, so the console cable is
            the USB-C.

        config EXAMPLE_USB_PORT_HIGH_SPEED
            bool "USB 2.0 high-speed port (ESP32-P4-ETH: the 4-pin USB connector)"

        config EXAMPLE_USB_PORT_FS_USBC
            bool "USB 1.1 full-speed port on the USB-C pads (GPIO 24 / 25)"

        config EXAMPLE_USB_PORT_DEFAULT
            bool "TinyUSB's default for the target"
    endchoice

endmenu
```

## holo_deck_mib/main/Kconfig.projbuild
```kconfig
menu "Holo Deck MIB Configuration"

    choice HOLO_DECK_MIB_DHCP_MODE
        prompt "Ethernet DHCP mode"
        default HOLO_DECK_MIB_DHCP_SERVER
        help
            The joystick HMI (pace-hmi-fw) is a DHCP client. On a direct cable
            between the HMI and this board (the chair topology, no router) this
            board must hand out the address: DHCP server, 192.168.4.1/24. On a
            bench LAN with a router, use DHCP client so the PC tools
            (rtps_mcb_gui.py etc.) share one subnet with both boards.

        config HOLO_DECK_MIB_DHCP_SERVER
            bool "DHCP server (192.168.4.1/24) - direct cable to the HMI"
        config HOLO_DECK_MIB_DHCP_CLIENT
            bool "DHCP client - bench LAN with a router"
    endchoice

endmenu
```

## pear/main/Kconfig.projbuild
```kconfig
menu "PEAR MIB Configuration"

    choice PEAR_DHCP_MODE
        prompt "Ethernet DHCP mode"
        default PEAR_DHCP_SERVER
        help
            The joystick HMI (pace-hmi-fw) is a DHCP client. On a direct cable
            between the HMI and this board (the chair topology, no router) this
            board must hand out the address: DHCP server, 192.168.4.1/24. On a
            bench LAN with a router, use DHCP client so the PC tools
            (rtps_mcb_gui.py etc.) share one subnet with both boards.

        config PEAR_DHCP_SERVER
            bool "DHCP server (192.168.4.1/24) - direct cable to the HMI"
        config PEAR_DHCP_CLIENT
            bool "DHCP client - bench LAN with a router"
    endchoice

endmenu
```
